;
; File Name: cyfitterrv.inc
; 
; PSoC Creator  4.4
;
; Description:
; 
;
;-------------------------------------------------------------------------------
; Copyright (c) 2007-2020 Cypress Semiconductor.  All rights reserved.
; You may use this file only in accordance with the license, terms, conditions, 
; disclaimers, and limitations in the end user license agreement accompanying 
; the software package with which this file was provided.
;-------------------------------------------------------------------------------

    IF :LNOT::DEF:INCLUDED_CYFITTERRV_INC
INCLUDED_CYFITTERRV_INC EQU 1
    GET cydevicerv.inc
    GET cydevicerv_trm.inc

; M1_D1
M1_D1__0__INTTYPE EQU CYREG_PICU3_INTTYPE1
M1_D1__0__MASK EQU 0x02
M1_D1__0__PC EQU CYREG_PRT3_PC1
M1_D1__0__PORT EQU 3
M1_D1__0__SHIFT EQU 1
M1_D1__AG EQU CYREG_PRT3_AG
M1_D1__AMUX EQU CYREG_PRT3_AMUX
M1_D1__BIE EQU CYREG_PRT3_BIE
M1_D1__BIT_MASK EQU CYREG_PRT3_BIT_MASK
M1_D1__BYP EQU CYREG_PRT3_BYP
M1_D1__CTL EQU CYREG_PRT3_CTL
M1_D1__DM0 EQU CYREG_PRT3_DM0
M1_D1__DM1 EQU CYREG_PRT3_DM1
M1_D1__DM2 EQU CYREG_PRT3_DM2
M1_D1__DR EQU CYREG_PRT3_DR
M1_D1__INP_DIS EQU CYREG_PRT3_INP_DIS
M1_D1__INTTYPE_BASE EQU CYDEV_PICU_INTTYPE_PICU3_BASE
M1_D1__LCD_COM_SEG EQU CYREG_PRT3_LCD_COM_SEG
M1_D1__LCD_EN EQU CYREG_PRT3_LCD_EN
M1_D1__MASK EQU 0x02
M1_D1__PORT EQU 3
M1_D1__PRT EQU CYREG_PRT3_PRT
M1_D1__PRTDSI__CAPS_SEL EQU CYREG_PRT3_CAPS_SEL
M1_D1__PRTDSI__DBL_SYNC_IN EQU CYREG_PRT3_DBL_SYNC_IN
M1_D1__PRTDSI__OE_SEL0 EQU CYREG_PRT3_OE_SEL0
M1_D1__PRTDSI__OE_SEL1 EQU CYREG_PRT3_OE_SEL1
M1_D1__PRTDSI__OUT_SEL0 EQU CYREG_PRT3_OUT_SEL0
M1_D1__PRTDSI__OUT_SEL1 EQU CYREG_PRT3_OUT_SEL1
M1_D1__PRTDSI__SYNC_OUT EQU CYREG_PRT3_SYNC_OUT
M1_D1__PS EQU CYREG_PRT3_PS
M1_D1__SHIFT EQU 1
M1_D1__SLW EQU CYREG_PRT3_SLW

; M1_D2
M1_D2__0__INTTYPE EQU CYREG_PICU3_INTTYPE2
M1_D2__0__MASK EQU 0x04
M1_D2__0__PC EQU CYREG_PRT3_PC2
M1_D2__0__PORT EQU 3
M1_D2__0__SHIFT EQU 2
M1_D2__AG EQU CYREG_PRT3_AG
M1_D2__AMUX EQU CYREG_PRT3_AMUX
M1_D2__BIE EQU CYREG_PRT3_BIE
M1_D2__BIT_MASK EQU CYREG_PRT3_BIT_MASK
M1_D2__BYP EQU CYREG_PRT3_BYP
M1_D2__CTL EQU CYREG_PRT3_CTL
M1_D2__DM0 EQU CYREG_PRT3_DM0
M1_D2__DM1 EQU CYREG_PRT3_DM1
M1_D2__DM2 EQU CYREG_PRT3_DM2
M1_D2__DR EQU CYREG_PRT3_DR
M1_D2__INP_DIS EQU CYREG_PRT3_INP_DIS
M1_D2__INTTYPE_BASE EQU CYDEV_PICU_INTTYPE_PICU3_BASE
M1_D2__LCD_COM_SEG EQU CYREG_PRT3_LCD_COM_SEG
M1_D2__LCD_EN EQU CYREG_PRT3_LCD_EN
M1_D2__MASK EQU 0x04
M1_D2__PORT EQU 3
M1_D2__PRT EQU CYREG_PRT3_PRT
M1_D2__PRTDSI__CAPS_SEL EQU CYREG_PRT3_CAPS_SEL
M1_D2__PRTDSI__DBL_SYNC_IN EQU CYREG_PRT3_DBL_SYNC_IN
M1_D2__PRTDSI__OE_SEL0 EQU CYREG_PRT3_OE_SEL0
M1_D2__PRTDSI__OE_SEL1 EQU CYREG_PRT3_OE_SEL1
M1_D2__PRTDSI__OUT_SEL0 EQU CYREG_PRT3_OUT_SEL0
M1_D2__PRTDSI__OUT_SEL1 EQU CYREG_PRT3_OUT_SEL1
M1_D2__PRTDSI__SYNC_OUT EQU CYREG_PRT3_SYNC_OUT
M1_D2__PS EQU CYREG_PRT3_PS
M1_D2__SHIFT EQU 2
M1_D2__SLW EQU CYREG_PRT3_SLW

; M1_EN
M1_EN__0__INTTYPE EQU CYREG_PICU3_INTTYPE3
M1_EN__0__MASK EQU 0x08
M1_EN__0__PC EQU CYREG_PRT3_PC3
M1_EN__0__PORT EQU 3
M1_EN__0__SHIFT EQU 3
M1_EN__AG EQU CYREG_PRT3_AG
M1_EN__AMUX EQU CYREG_PRT3_AMUX
M1_EN__BIE EQU CYREG_PRT3_BIE
M1_EN__BIT_MASK EQU CYREG_PRT3_BIT_MASK
M1_EN__BYP EQU CYREG_PRT3_BYP
M1_EN__CTL EQU CYREG_PRT3_CTL
M1_EN__DM0 EQU CYREG_PRT3_DM0
M1_EN__DM1 EQU CYREG_PRT3_DM1
M1_EN__DM2 EQU CYREG_PRT3_DM2
M1_EN__DR EQU CYREG_PRT3_DR
M1_EN__INP_DIS EQU CYREG_PRT3_INP_DIS
M1_EN__INTTYPE_BASE EQU CYDEV_PICU_INTTYPE_PICU3_BASE
M1_EN__LCD_COM_SEG EQU CYREG_PRT3_LCD_COM_SEG
M1_EN__LCD_EN EQU CYREG_PRT3_LCD_EN
M1_EN__MASK EQU 0x08
M1_EN__PORT EQU 3
M1_EN__PRT EQU CYREG_PRT3_PRT
M1_EN__PRTDSI__CAPS_SEL EQU CYREG_PRT3_CAPS_SEL
M1_EN__PRTDSI__DBL_SYNC_IN EQU CYREG_PRT3_DBL_SYNC_IN
M1_EN__PRTDSI__OE_SEL0 EQU CYREG_PRT3_OE_SEL0
M1_EN__PRTDSI__OE_SEL1 EQU CYREG_PRT3_OE_SEL1
M1_EN__PRTDSI__OUT_SEL0 EQU CYREG_PRT3_OUT_SEL0
M1_EN__PRTDSI__OUT_SEL1 EQU CYREG_PRT3_OUT_SEL1
M1_EN__PRTDSI__SYNC_OUT EQU CYREG_PRT3_SYNC_OUT
M1_EN__PS EQU CYREG_PRT3_PS
M1_EN__SHIFT EQU 3
M1_EN__SLW EQU CYREG_PRT3_SLW

; M1_QA
M1_QA__0__INTTYPE EQU CYREG_PICU15_INTTYPE1
M1_QA__0__MASK EQU 0x02
M1_QA__0__PC EQU CYREG_IO_PC_PRT15_PC1
M1_QA__0__PORT EQU 15
M1_QA__0__SHIFT EQU 1
M1_QA__AG EQU CYREG_PRT15_AG
M1_QA__AMUX EQU CYREG_PRT15_AMUX
M1_QA__BIE EQU CYREG_PRT15_BIE
M1_QA__BIT_MASK EQU CYREG_PRT15_BIT_MASK
M1_QA__BYP EQU CYREG_PRT15_BYP
M1_QA__CTL EQU CYREG_PRT15_CTL
M1_QA__DM0 EQU CYREG_PRT15_DM0
M1_QA__DM1 EQU CYREG_PRT15_DM1
M1_QA__DM2 EQU CYREG_PRT15_DM2
M1_QA__DR EQU CYREG_PRT15_DR
M1_QA__INP_DIS EQU CYREG_PRT15_INP_DIS
M1_QA__INTTYPE_BASE EQU CYDEV_PICU_INTTYPE_PICU15_BASE
M1_QA__LCD_COM_SEG EQU CYREG_PRT15_LCD_COM_SEG
M1_QA__LCD_EN EQU CYREG_PRT15_LCD_EN
M1_QA__MASK EQU 0x02
M1_QA__PORT EQU 15
M1_QA__PRT EQU CYREG_PRT15_PRT
M1_QA__PRTDSI__CAPS_SEL EQU CYREG_PRT15_CAPS_SEL
M1_QA__PRTDSI__DBL_SYNC_IN EQU CYREG_PRT15_DBL_SYNC_IN
M1_QA__PRTDSI__OE_SEL0 EQU CYREG_PRT15_OE_SEL0
M1_QA__PRTDSI__OE_SEL1 EQU CYREG_PRT15_OE_SEL1
M1_QA__PRTDSI__OUT_SEL0 EQU CYREG_PRT15_OUT_SEL0
M1_QA__PRTDSI__OUT_SEL1 EQU CYREG_PRT15_OUT_SEL1
M1_QA__PRTDSI__SYNC_OUT EQU CYREG_PRT15_SYNC_OUT
M1_QA__PS EQU CYREG_PRT15_PS
M1_QA__SHIFT EQU 1
M1_QA__SLW EQU CYREG_PRT15_SLW

; M1_QB
M1_QB__0__INTTYPE EQU CYREG_PICU15_INTTYPE2
M1_QB__0__MASK EQU 0x04
M1_QB__0__PC EQU CYREG_IO_PC_PRT15_PC2
M1_QB__0__PORT EQU 15
M1_QB__0__SHIFT EQU 2
M1_QB__AG EQU CYREG_PRT15_AG
M1_QB__AMUX EQU CYREG_PRT15_AMUX
M1_QB__BIE EQU CYREG_PRT15_BIE
M1_QB__BIT_MASK EQU CYREG_PRT15_BIT_MASK
M1_QB__BYP EQU CYREG_PRT15_BYP
M1_QB__CTL EQU CYREG_PRT15_CTL
M1_QB__DM0 EQU CYREG_PRT15_DM0
M1_QB__DM1 EQU CYREG_PRT15_DM1
M1_QB__DM2 EQU CYREG_PRT15_DM2
M1_QB__DR EQU CYREG_PRT15_DR
M1_QB__INP_DIS EQU CYREG_PRT15_INP_DIS
M1_QB__INTTYPE_BASE EQU CYDEV_PICU_INTTYPE_PICU15_BASE
M1_QB__LCD_COM_SEG EQU CYREG_PRT15_LCD_COM_SEG
M1_QB__LCD_EN EQU CYREG_PRT15_LCD_EN
M1_QB__MASK EQU 0x04
M1_QB__PORT EQU 15
M1_QB__PRT EQU CYREG_PRT15_PRT
M1_QB__PRTDSI__CAPS_SEL EQU CYREG_PRT15_CAPS_SEL
M1_QB__PRTDSI__DBL_SYNC_IN EQU CYREG_PRT15_DBL_SYNC_IN
M1_QB__PRTDSI__OE_SEL0 EQU CYREG_PRT15_OE_SEL0
M1_QB__PRTDSI__OE_SEL1 EQU CYREG_PRT15_OE_SEL1
M1_QB__PRTDSI__OUT_SEL0 EQU CYREG_PRT15_OUT_SEL0
M1_QB__PRTDSI__OUT_SEL1 EQU CYREG_PRT15_OUT_SEL1
M1_QB__PRTDSI__SYNC_OUT EQU CYREG_PRT15_SYNC_OUT
M1_QB__PS EQU CYREG_PRT15_PS
M1_QB__SHIFT EQU 2
M1_QB__SLW EQU CYREG_PRT15_SLW

; PWM_1
PWM_1_PWMHW__CAP0 EQU CYREG_TMR0_CAP0
PWM_1_PWMHW__CAP1 EQU CYREG_TMR0_CAP1
PWM_1_PWMHW__CFG0 EQU CYREG_TMR0_CFG0
PWM_1_PWMHW__CFG1 EQU CYREG_TMR0_CFG1
PWM_1_PWMHW__CFG2 EQU CYREG_TMR0_CFG2
PWM_1_PWMHW__CNT_CMP0 EQU CYREG_TMR0_CNT_CMP0
PWM_1_PWMHW__CNT_CMP1 EQU CYREG_TMR0_CNT_CMP1
PWM_1_PWMHW__PER0 EQU CYREG_TMR0_PER0
PWM_1_PWMHW__PER1 EQU CYREG_TMR0_PER1
PWM_1_PWMHW__PM_ACT_CFG EQU CYREG_PM_ACT_CFG3
PWM_1_PWMHW__PM_ACT_MSK EQU 0x01
PWM_1_PWMHW__PM_STBY_CFG EQU CYREG_PM_STBY_CFG3
PWM_1_PWMHW__PM_STBY_MSK EQU 0x01
PWM_1_PWMHW__RT0 EQU CYREG_TMR0_RT0
PWM_1_PWMHW__RT1 EQU CYREG_TMR0_RT1
PWM_1_PWMHW__SR0 EQU CYREG_TMR0_SR0

; M1_IN1
M1_IN1__0__INTTYPE EQU CYREG_PICU3_INTTYPE5
M1_IN1__0__MASK EQU 0x20
M1_IN1__0__PC EQU CYREG_PRT3_PC5
M1_IN1__0__PORT EQU 3
M1_IN1__0__SHIFT EQU 5
M1_IN1__AG EQU CYREG_PRT3_AG
M1_IN1__AMUX EQU CYREG_PRT3_AMUX
M1_IN1__BIE EQU CYREG_PRT3_BIE
M1_IN1__BIT_MASK EQU CYREG_PRT3_BIT_MASK
M1_IN1__BYP EQU CYREG_PRT3_BYP
M1_IN1__CTL EQU CYREG_PRT3_CTL
M1_IN1__DM0 EQU CYREG_PRT3_DM0
M1_IN1__DM1 EQU CYREG_PRT3_DM1
M1_IN1__DM2 EQU CYREG_PRT3_DM2
M1_IN1__DR EQU CYREG_PRT3_DR
M1_IN1__INP_DIS EQU CYREG_PRT3_INP_DIS
M1_IN1__INTTYPE_BASE EQU CYDEV_PICU_INTTYPE_PICU3_BASE
M1_IN1__LCD_COM_SEG EQU CYREG_PRT3_LCD_COM_SEG
M1_IN1__LCD_EN EQU CYREG_PRT3_LCD_EN
M1_IN1__MASK EQU 0x20
M1_IN1__PORT EQU 3
M1_IN1__PRT EQU CYREG_PRT3_PRT
M1_IN1__PRTDSI__CAPS_SEL EQU CYREG_PRT3_CAPS_SEL
M1_IN1__PRTDSI__DBL_SYNC_IN EQU CYREG_PRT3_DBL_SYNC_IN
M1_IN1__PRTDSI__OE_SEL0 EQU CYREG_PRT3_OE_SEL0
M1_IN1__PRTDSI__OE_SEL1 EQU CYREG_PRT3_OE_SEL1
M1_IN1__PRTDSI__OUT_SEL0 EQU CYREG_PRT3_OUT_SEL0
M1_IN1__PRTDSI__OUT_SEL1 EQU CYREG_PRT3_OUT_SEL1
M1_IN1__PRTDSI__SYNC_OUT EQU CYREG_PRT3_SYNC_OUT
M1_IN1__PS EQU CYREG_PRT3_PS
M1_IN1__SHIFT EQU 5
M1_IN1__SLW EQU CYREG_PRT3_SLW

; M1_IN2
M1_IN2__0__INTTYPE EQU CYREG_PICU3_INTTYPE4
M1_IN2__0__MASK EQU 0x10
M1_IN2__0__PC EQU CYREG_PRT3_PC4
M1_IN2__0__PORT EQU 3
M1_IN2__0__SHIFT EQU 4
M1_IN2__AG EQU CYREG_PRT3_AG
M1_IN2__AMUX EQU CYREG_PRT3_AMUX
M1_IN2__BIE EQU CYREG_PRT3_BIE
M1_IN2__BIT_MASK EQU CYREG_PRT3_BIT_MASK
M1_IN2__BYP EQU CYREG_PRT3_BYP
M1_IN2__CTL EQU CYREG_PRT3_CTL
M1_IN2__DM0 EQU CYREG_PRT3_DM0
M1_IN2__DM1 EQU CYREG_PRT3_DM1
M1_IN2__DM2 EQU CYREG_PRT3_DM2
M1_IN2__DR EQU CYREG_PRT3_DR
M1_IN2__INP_DIS EQU CYREG_PRT3_INP_DIS
M1_IN2__INTTYPE_BASE EQU CYDEV_PICU_INTTYPE_PICU3_BASE
M1_IN2__LCD_COM_SEG EQU CYREG_PRT3_LCD_COM_SEG
M1_IN2__LCD_EN EQU CYREG_PRT3_LCD_EN
M1_IN2__MASK EQU 0x10
M1_IN2__PORT EQU 3
M1_IN2__PRT EQU CYREG_PRT3_PRT
M1_IN2__PRTDSI__CAPS_SEL EQU CYREG_PRT3_CAPS_SEL
M1_IN2__PRTDSI__DBL_SYNC_IN EQU CYREG_PRT3_DBL_SYNC_IN
M1_IN2__PRTDSI__OE_SEL0 EQU CYREG_PRT3_OE_SEL0
M1_IN2__PRTDSI__OE_SEL1 EQU CYREG_PRT3_OE_SEL1
M1_IN2__PRTDSI__OUT_SEL0 EQU CYREG_PRT3_OUT_SEL0
M1_IN2__PRTDSI__OUT_SEL1 EQU CYREG_PRT3_OUT_SEL1
M1_IN2__PRTDSI__SYNC_OUT EQU CYREG_PRT3_SYNC_OUT
M1_IN2__PS EQU CYREG_PRT3_PS
M1_IN2__SHIFT EQU 4
M1_IN2__SLW EQU CYREG_PRT3_SLW

; Clock_PWM
Clock_PWM__CFG0 EQU CYREG_CLKDIST_DCFG1_CFG0
Clock_PWM__CFG1 EQU CYREG_CLKDIST_DCFG1_CFG1
Clock_PWM__CFG2 EQU CYREG_CLKDIST_DCFG1_CFG2
Clock_PWM__CFG2_SRC_SEL_MASK EQU 0x07
Clock_PWM__INDEX EQU 0x01
Clock_PWM__PM_ACT_CFG EQU CYREG_PM_ACT_CFG2
Clock_PWM__PM_ACT_MSK EQU 0x02
Clock_PWM__PM_STBY_CFG EQU CYREG_PM_STBY_CFG2
Clock_PWM__PM_STBY_MSK EQU 0x02

; Clock_QENC
Clock_QENC__CFG0 EQU CYREG_CLKDIST_DCFG0_CFG0
Clock_QENC__CFG1 EQU CYREG_CLKDIST_DCFG0_CFG1
Clock_QENC__CFG2 EQU CYREG_CLKDIST_DCFG0_CFG2
Clock_QENC__CFG2_SRC_SEL_MASK EQU 0x07
Clock_QENC__INDEX EQU 0x00
Clock_QENC__PM_ACT_CFG EQU CYREG_PM_ACT_CFG2
Clock_QENC__PM_ACT_MSK EQU 0x01
Clock_QENC__PM_STBY_CFG EQU CYREG_PM_STBY_CFG2
Clock_QENC__PM_STBY_MSK EQU 0x01

; QuadDec_M1
QuadDec_M1_bQuadDec_Stsreg__0__MASK EQU 0x01
QuadDec_M1_bQuadDec_Stsreg__0__POS EQU 0
QuadDec_M1_bQuadDec_Stsreg__1__MASK EQU 0x02
QuadDec_M1_bQuadDec_Stsreg__1__POS EQU 1
QuadDec_M1_bQuadDec_Stsreg__16BIT_STATUS_AUX_CTL_REG EQU CYREG_B1_UDB05_06_ACTL
QuadDec_M1_bQuadDec_Stsreg__16BIT_STATUS_REG EQU CYREG_B1_UDB05_06_ST
QuadDec_M1_bQuadDec_Stsreg__2__MASK EQU 0x04
QuadDec_M1_bQuadDec_Stsreg__2__POS EQU 2
QuadDec_M1_bQuadDec_Stsreg__3__MASK EQU 0x08
QuadDec_M1_bQuadDec_Stsreg__3__POS EQU 3
QuadDec_M1_bQuadDec_Stsreg__MASK EQU 0x0F
QuadDec_M1_bQuadDec_Stsreg__MASK_REG EQU CYREG_B1_UDB05_MSK
QuadDec_M1_bQuadDec_Stsreg__MASK_ST_AUX_CTL_REG EQU CYREG_B1_UDB05_MSK_ACTL
QuadDec_M1_bQuadDec_Stsreg__PER_ST_AUX_CTL_REG EQU CYREG_B1_UDB05_MSK_ACTL
QuadDec_M1_bQuadDec_Stsreg__STATUS_AUX_CTL_REG EQU CYREG_B1_UDB05_ACTL
QuadDec_M1_bQuadDec_Stsreg__STATUS_CNT_REG EQU CYREG_B1_UDB05_ST_CTL
QuadDec_M1_bQuadDec_Stsreg__STATUS_CONTROL_REG EQU CYREG_B1_UDB05_ST_CTL
QuadDec_M1_bQuadDec_Stsreg__STATUS_REG EQU CYREG_B1_UDB05_ST
QuadDec_M1_Cnt16_CounterUDB_sC16_counterdp_u0__16BIT_A0_REG EQU CYREG_B1_UDB06_07_A0
QuadDec_M1_Cnt16_CounterUDB_sC16_counterdp_u0__16BIT_A1_REG EQU CYREG_B1_UDB06_07_A1
QuadDec_M1_Cnt16_CounterUDB_sC16_counterdp_u0__16BIT_D0_REG EQU CYREG_B1_UDB06_07_D0
QuadDec_M1_Cnt16_CounterUDB_sC16_counterdp_u0__16BIT_D1_REG EQU CYREG_B1_UDB06_07_D1
QuadDec_M1_Cnt16_CounterUDB_sC16_counterdp_u0__16BIT_DP_AUX_CTL_REG EQU CYREG_B1_UDB06_07_ACTL
QuadDec_M1_Cnt16_CounterUDB_sC16_counterdp_u0__16BIT_F0_REG EQU CYREG_B1_UDB06_07_F0
QuadDec_M1_Cnt16_CounterUDB_sC16_counterdp_u0__16BIT_F1_REG EQU CYREG_B1_UDB06_07_F1
QuadDec_M1_Cnt16_CounterUDB_sC16_counterdp_u0__A0_A1_REG EQU CYREG_B1_UDB06_A0_A1
QuadDec_M1_Cnt16_CounterUDB_sC16_counterdp_u0__A0_REG EQU CYREG_B1_UDB06_A0
QuadDec_M1_Cnt16_CounterUDB_sC16_counterdp_u0__A1_REG EQU CYREG_B1_UDB06_A1
QuadDec_M1_Cnt16_CounterUDB_sC16_counterdp_u0__D0_D1_REG EQU CYREG_B1_UDB06_D0_D1
QuadDec_M1_Cnt16_CounterUDB_sC16_counterdp_u0__D0_REG EQU CYREG_B1_UDB06_D0
QuadDec_M1_Cnt16_CounterUDB_sC16_counterdp_u0__D1_REG EQU CYREG_B1_UDB06_D1
QuadDec_M1_Cnt16_CounterUDB_sC16_counterdp_u0__DP_AUX_CTL_REG EQU CYREG_B1_UDB06_ACTL
QuadDec_M1_Cnt16_CounterUDB_sC16_counterdp_u0__F0_F1_REG EQU CYREG_B1_UDB06_F0_F1
QuadDec_M1_Cnt16_CounterUDB_sC16_counterdp_u0__F0_REG EQU CYREG_B1_UDB06_F0
QuadDec_M1_Cnt16_CounterUDB_sC16_counterdp_u0__F1_REG EQU CYREG_B1_UDB06_F1
QuadDec_M1_Cnt16_CounterUDB_sC16_counterdp_u1__16BIT_A0_REG EQU CYREG_B1_UDB07_08_A0
QuadDec_M1_Cnt16_CounterUDB_sC16_counterdp_u1__16BIT_A1_REG EQU CYREG_B1_UDB07_08_A1
QuadDec_M1_Cnt16_CounterUDB_sC16_counterdp_u1__16BIT_D0_REG EQU CYREG_B1_UDB07_08_D0
QuadDec_M1_Cnt16_CounterUDB_sC16_counterdp_u1__16BIT_D1_REG EQU CYREG_B1_UDB07_08_D1
QuadDec_M1_Cnt16_CounterUDB_sC16_counterdp_u1__16BIT_DP_AUX_CTL_REG EQU CYREG_B1_UDB07_08_ACTL
QuadDec_M1_Cnt16_CounterUDB_sC16_counterdp_u1__16BIT_F0_REG EQU CYREG_B1_UDB07_08_F0
QuadDec_M1_Cnt16_CounterUDB_sC16_counterdp_u1__16BIT_F1_REG EQU CYREG_B1_UDB07_08_F1
QuadDec_M1_Cnt16_CounterUDB_sC16_counterdp_u1__A0_A1_REG EQU CYREG_B1_UDB07_A0_A1
QuadDec_M1_Cnt16_CounterUDB_sC16_counterdp_u1__A0_REG EQU CYREG_B1_UDB07_A0
QuadDec_M1_Cnt16_CounterUDB_sC16_counterdp_u1__A1_REG EQU CYREG_B1_UDB07_A1
QuadDec_M1_Cnt16_CounterUDB_sC16_counterdp_u1__D0_D1_REG EQU CYREG_B1_UDB07_D0_D1
QuadDec_M1_Cnt16_CounterUDB_sC16_counterdp_u1__D0_REG EQU CYREG_B1_UDB07_D0
QuadDec_M1_Cnt16_CounterUDB_sC16_counterdp_u1__D1_REG EQU CYREG_B1_UDB07_D1
QuadDec_M1_Cnt16_CounterUDB_sC16_counterdp_u1__DP_AUX_CTL_REG EQU CYREG_B1_UDB07_ACTL
QuadDec_M1_Cnt16_CounterUDB_sC16_counterdp_u1__F0_F1_REG EQU CYREG_B1_UDB07_F0_F1
QuadDec_M1_Cnt16_CounterUDB_sC16_counterdp_u1__F0_REG EQU CYREG_B1_UDB07_F0
QuadDec_M1_Cnt16_CounterUDB_sC16_counterdp_u1__F1_REG EQU CYREG_B1_UDB07_F1
QuadDec_M1_Cnt16_CounterUDB_sC16_counterdp_u1__MSK_DP_AUX_CTL_REG EQU CYREG_B1_UDB07_MSK_ACTL
QuadDec_M1_Cnt16_CounterUDB_sC16_counterdp_u1__PER_DP_AUX_CTL_REG EQU CYREG_B1_UDB07_MSK_ACTL
QuadDec_M1_Cnt16_CounterUDB_sCTRLReg_ctrlreg__16BIT_CONTROL_AUX_CTL_REG EQU CYREG_B1_UDB07_08_ACTL
QuadDec_M1_Cnt16_CounterUDB_sCTRLReg_ctrlreg__16BIT_CONTROL_CONTROL_REG EQU CYREG_B1_UDB07_08_CTL
QuadDec_M1_Cnt16_CounterUDB_sCTRLReg_ctrlreg__16BIT_CONTROL_COUNT_REG EQU CYREG_B1_UDB07_08_CTL
QuadDec_M1_Cnt16_CounterUDB_sCTRLReg_ctrlreg__16BIT_COUNT_CONTROL_REG EQU CYREG_B1_UDB07_08_CTL
QuadDec_M1_Cnt16_CounterUDB_sCTRLReg_ctrlreg__16BIT_COUNT_COUNT_REG EQU CYREG_B1_UDB07_08_CTL
QuadDec_M1_Cnt16_CounterUDB_sCTRLReg_ctrlreg__16BIT_MASK_MASK_REG EQU CYREG_B1_UDB07_08_MSK
QuadDec_M1_Cnt16_CounterUDB_sCTRLReg_ctrlreg__16BIT_MASK_PERIOD_REG EQU CYREG_B1_UDB07_08_MSK
QuadDec_M1_Cnt16_CounterUDB_sCTRLReg_ctrlreg__16BIT_PERIOD_MASK_REG EQU CYREG_B1_UDB07_08_MSK
QuadDec_M1_Cnt16_CounterUDB_sCTRLReg_ctrlreg__16BIT_PERIOD_PERIOD_REG EQU CYREG_B1_UDB07_08_MSK
QuadDec_M1_Cnt16_CounterUDB_sCTRLReg_ctrlreg__7__MASK EQU 0x80
QuadDec_M1_Cnt16_CounterUDB_sCTRLReg_ctrlreg__7__POS EQU 7
QuadDec_M1_Cnt16_CounterUDB_sCTRLReg_ctrlreg__CONTROL_AUX_CTL_REG EQU CYREG_B1_UDB07_ACTL
QuadDec_M1_Cnt16_CounterUDB_sCTRLReg_ctrlreg__CONTROL_REG EQU CYREG_B1_UDB07_CTL
QuadDec_M1_Cnt16_CounterUDB_sCTRLReg_ctrlreg__CONTROL_ST_REG EQU CYREG_B1_UDB07_ST_CTL
QuadDec_M1_Cnt16_CounterUDB_sCTRLReg_ctrlreg__COUNT_REG EQU CYREG_B1_UDB07_CTL
QuadDec_M1_Cnt16_CounterUDB_sCTRLReg_ctrlreg__COUNT_ST_REG EQU CYREG_B1_UDB07_ST_CTL
QuadDec_M1_Cnt16_CounterUDB_sCTRLReg_ctrlreg__MASK EQU 0x80
QuadDec_M1_Cnt16_CounterUDB_sCTRLReg_ctrlreg__MASK_CTL_AUX_CTL_REG EQU CYREG_B1_UDB07_MSK_ACTL
QuadDec_M1_Cnt16_CounterUDB_sCTRLReg_ctrlreg__PER_CTL_AUX_CTL_REG EQU CYREG_B1_UDB07_MSK_ACTL
QuadDec_M1_Cnt16_CounterUDB_sCTRLReg_ctrlreg__PERIOD_REG EQU CYREG_B1_UDB07_MSK
QuadDec_M1_Cnt16_CounterUDB_sSTSReg_stsreg__0__MASK EQU 0x01
QuadDec_M1_Cnt16_CounterUDB_sSTSReg_stsreg__0__POS EQU 0
QuadDec_M1_Cnt16_CounterUDB_sSTSReg_stsreg__1__MASK EQU 0x02
QuadDec_M1_Cnt16_CounterUDB_sSTSReg_stsreg__1__POS EQU 1
QuadDec_M1_Cnt16_CounterUDB_sSTSReg_stsreg__16BIT_STATUS_AUX_CTL_REG EQU CYREG_B1_UDB04_05_ACTL
QuadDec_M1_Cnt16_CounterUDB_sSTSReg_stsreg__16BIT_STATUS_REG EQU CYREG_B1_UDB04_05_ST
QuadDec_M1_Cnt16_CounterUDB_sSTSReg_stsreg__2__MASK EQU 0x04
QuadDec_M1_Cnt16_CounterUDB_sSTSReg_stsreg__2__POS EQU 2
QuadDec_M1_Cnt16_CounterUDB_sSTSReg_stsreg__3__MASK EQU 0x08
QuadDec_M1_Cnt16_CounterUDB_sSTSReg_stsreg__3__POS EQU 3
QuadDec_M1_Cnt16_CounterUDB_sSTSReg_stsreg__5__MASK EQU 0x20
QuadDec_M1_Cnt16_CounterUDB_sSTSReg_stsreg__5__POS EQU 5
QuadDec_M1_Cnt16_CounterUDB_sSTSReg_stsreg__6__MASK EQU 0x40
QuadDec_M1_Cnt16_CounterUDB_sSTSReg_stsreg__6__POS EQU 6
QuadDec_M1_Cnt16_CounterUDB_sSTSReg_stsreg__MASK EQU 0x6F
QuadDec_M1_Cnt16_CounterUDB_sSTSReg_stsreg__MASK_REG EQU CYREG_B1_UDB04_MSK
QuadDec_M1_Cnt16_CounterUDB_sSTSReg_stsreg__STATUS_AUX_CTL_REG EQU CYREG_B1_UDB04_ACTL
QuadDec_M1_Cnt16_CounterUDB_sSTSReg_stsreg__STATUS_REG EQU CYREG_B1_UDB04_ST

; Control_Reg_1
Control_Reg_1_Sync_ctrl_reg__0__MASK EQU 0x01
Control_Reg_1_Sync_ctrl_reg__0__POS EQU 0
Control_Reg_1_Sync_ctrl_reg__1__MASK EQU 0x02
Control_Reg_1_Sync_ctrl_reg__1__POS EQU 1
Control_Reg_1_Sync_ctrl_reg__16BIT_CONTROL_AUX_CTL_REG EQU CYREG_B1_UDB05_06_ACTL
Control_Reg_1_Sync_ctrl_reg__16BIT_CONTROL_CONTROL_REG EQU CYREG_B1_UDB05_06_CTL
Control_Reg_1_Sync_ctrl_reg__16BIT_CONTROL_COUNT_REG EQU CYREG_B1_UDB05_06_CTL
Control_Reg_1_Sync_ctrl_reg__16BIT_COUNT_CONTROL_REG EQU CYREG_B1_UDB05_06_CTL
Control_Reg_1_Sync_ctrl_reg__16BIT_COUNT_COUNT_REG EQU CYREG_B1_UDB05_06_CTL
Control_Reg_1_Sync_ctrl_reg__16BIT_MASK_MASK_REG EQU CYREG_B1_UDB05_06_MSK
Control_Reg_1_Sync_ctrl_reg__16BIT_MASK_PERIOD_REG EQU CYREG_B1_UDB05_06_MSK
Control_Reg_1_Sync_ctrl_reg__16BIT_PERIOD_MASK_REG EQU CYREG_B1_UDB05_06_MSK
Control_Reg_1_Sync_ctrl_reg__16BIT_PERIOD_PERIOD_REG EQU CYREG_B1_UDB05_06_MSK
Control_Reg_1_Sync_ctrl_reg__2__MASK EQU 0x04
Control_Reg_1_Sync_ctrl_reg__2__POS EQU 2
Control_Reg_1_Sync_ctrl_reg__CONTROL_AUX_CTL_REG EQU CYREG_B1_UDB05_ACTL
Control_Reg_1_Sync_ctrl_reg__CONTROL_REG EQU CYREG_B1_UDB05_CTL
Control_Reg_1_Sync_ctrl_reg__CONTROL_ST_REG EQU CYREG_B1_UDB05_ST_CTL
Control_Reg_1_Sync_ctrl_reg__COUNT_REG EQU CYREG_B1_UDB05_CTL
Control_Reg_1_Sync_ctrl_reg__COUNT_ST_REG EQU CYREG_B1_UDB05_ST_CTL
Control_Reg_1_Sync_ctrl_reg__MASK EQU 0x07
Control_Reg_1_Sync_ctrl_reg__MASK_CTL_AUX_CTL_REG EQU CYREG_B1_UDB05_MSK_ACTL
Control_Reg_1_Sync_ctrl_reg__PER_CTL_AUX_CTL_REG EQU CYREG_B1_UDB05_MSK_ACTL
Control_Reg_1_Sync_ctrl_reg__PERIOD_REG EQU CYREG_B1_UDB05_MSK

; Miscellaneous
BCLK__BUS_CLK__HZ EQU 24000000
BCLK__BUS_CLK__KHZ EQU 24000
BCLK__BUS_CLK__MHZ EQU 24
CYDEV_CHIP_DIE_LEOPARD EQU 1
CYDEV_CHIP_DIE_PSOC4A EQU 26
CYDEV_CHIP_DIE_PSOC5LP EQU 2
CYDEV_CHIP_DIE_PSOC5TM EQU 3
CYDEV_CHIP_DIE_TMA4 EQU 4
CYDEV_CHIP_DIE_UNKNOWN EQU 0
CYDEV_CHIP_FAMILY_FM0P EQU 5
CYDEV_CHIP_FAMILY_FM3 EQU 6
CYDEV_CHIP_FAMILY_FM4 EQU 7
CYDEV_CHIP_FAMILY_PSOC3 EQU 1
CYDEV_CHIP_FAMILY_PSOC4 EQU 2
CYDEV_CHIP_FAMILY_PSOC5 EQU 3
CYDEV_CHIP_FAMILY_PSOC6 EQU 4
CYDEV_CHIP_FAMILY_UNKNOWN EQU 0
CYDEV_CHIP_FAMILY_USED EQU CYDEV_CHIP_FAMILY_PSOC5
CYDEV_CHIP_JTAG_ID EQU 0x2E161069
CYDEV_CHIP_MEMBER_3A EQU 1
CYDEV_CHIP_MEMBER_4A EQU 26
CYDEV_CHIP_MEMBER_4AA EQU 25
CYDEV_CHIP_MEMBER_4AB EQU 30
CYDEV_CHIP_MEMBER_4AC EQU 14
CYDEV_CHIP_MEMBER_4AD EQU 15
CYDEV_CHIP_MEMBER_4AE EQU 16
CYDEV_CHIP_MEMBER_4D EQU 20
CYDEV_CHIP_MEMBER_4E EQU 6
CYDEV_CHIP_MEMBER_4F EQU 27
CYDEV_CHIP_MEMBER_4G EQU 4
CYDEV_CHIP_MEMBER_4H EQU 24
CYDEV_CHIP_MEMBER_4I EQU 32
CYDEV_CHIP_MEMBER_4J EQU 21
CYDEV_CHIP_MEMBER_4K EQU 22
CYDEV_CHIP_MEMBER_4L EQU 31
CYDEV_CHIP_MEMBER_4M EQU 29
CYDEV_CHIP_MEMBER_4N EQU 11
CYDEV_CHIP_MEMBER_4O EQU 8
CYDEV_CHIP_MEMBER_4P EQU 28
CYDEV_CHIP_MEMBER_4Q EQU 17
CYDEV_CHIP_MEMBER_4R EQU 9
CYDEV_CHIP_MEMBER_4S EQU 12
CYDEV_CHIP_MEMBER_4T EQU 10
CYDEV_CHIP_MEMBER_4U EQU 5
CYDEV_CHIP_MEMBER_4V EQU 23
CYDEV_CHIP_MEMBER_4W EQU 13
CYDEV_CHIP_MEMBER_4X EQU 7
CYDEV_CHIP_MEMBER_4Y EQU 18
CYDEV_CHIP_MEMBER_4Z EQU 19
CYDEV_CHIP_MEMBER_5A EQU 3
CYDEV_CHIP_MEMBER_5B EQU 2
CYDEV_CHIP_MEMBER_6A EQU 33
CYDEV_CHIP_MEMBER_FM3 EQU 37
CYDEV_CHIP_MEMBER_FM4 EQU 38
CYDEV_CHIP_MEMBER_PDL_FM0P_TYPE1 EQU 34
CYDEV_CHIP_MEMBER_PDL_FM0P_TYPE2 EQU 35
CYDEV_CHIP_MEMBER_PDL_FM0P_TYPE3 EQU 36
CYDEV_CHIP_MEMBER_UNKNOWN EQU 0
CYDEV_CHIP_MEMBER_USED EQU CYDEV_CHIP_MEMBER_5B
CYDEV_CHIP_DIE_EXPECT EQU CYDEV_CHIP_MEMBER_USED
CYDEV_CHIP_DIE_ACTUAL EQU CYDEV_CHIP_DIE_EXPECT
CYDEV_CHIP_REV_LEOPARD_ES1 EQU 0
CYDEV_CHIP_REV_LEOPARD_ES2 EQU 1
CYDEV_CHIP_REV_LEOPARD_ES3 EQU 3
CYDEV_CHIP_REV_LEOPARD_PRODUCTION EQU 3
CYDEV_CHIP_REV_PSOC4A_ES0 EQU 17
CYDEV_CHIP_REV_PSOC4A_PRODUCTION EQU 17
CYDEV_CHIP_REV_PSOC5LP_ES0 EQU 0
CYDEV_CHIP_REV_PSOC5LP_PRODUCTION EQU 0
CYDEV_CHIP_REV_PSOC5TM_ES0 EQU 0
CYDEV_CHIP_REV_PSOC5TM_ES1 EQU 1
CYDEV_CHIP_REV_PSOC5TM_PRODUCTION EQU 1
CYDEV_CHIP_REV_TMA4_ES EQU 17
CYDEV_CHIP_REV_TMA4_ES2 EQU 33
CYDEV_CHIP_REV_TMA4_PRODUCTION EQU 17
CYDEV_CHIP_REVISION_3A_ES1 EQU 0
CYDEV_CHIP_REVISION_3A_ES2 EQU 1
CYDEV_CHIP_REVISION_3A_ES3 EQU 3
CYDEV_CHIP_REVISION_3A_PRODUCTION EQU 3
CYDEV_CHIP_REVISION_4A_ES0 EQU 17
CYDEV_CHIP_REVISION_4A_PRODUCTION EQU 17
CYDEV_CHIP_REVISION_4AA_PRODUCTION EQU 0
CYDEV_CHIP_REVISION_4AB_PRODUCTION EQU 0
CYDEV_CHIP_REVISION_4AC_PRODUCTION EQU 0
CYDEV_CHIP_REVISION_4AD_PRODUCTION EQU 0
CYDEV_CHIP_REVISION_4AE_PRODUCTION EQU 0
CYDEV_CHIP_REVISION_4D_PRODUCTION EQU 0
CYDEV_CHIP_REVISION_4E_CCG2_NO_USBPD EQU 0
CYDEV_CHIP_REVISION_4E_PRODUCTION EQU 0
CYDEV_CHIP_REVISION_4F_PRODUCTION EQU 0
CYDEV_CHIP_REVISION_4F_PRODUCTION_256DMA EQU 0
CYDEV_CHIP_REVISION_4F_PRODUCTION_256K EQU 0
CYDEV_CHIP_REVISION_4G_ES EQU 17
CYDEV_CHIP_REVISION_4G_ES2 EQU 33
CYDEV_CHIP_REVISION_4G_PRODUCTION EQU 17
CYDEV_CHIP_REVISION_4H_PRODUCTION EQU 0
CYDEV_CHIP_REVISION_4I_PRODUCTION EQU 0
CYDEV_CHIP_REVISION_4J_PRODUCTION EQU 0
CYDEV_CHIP_REVISION_4K_PRODUCTION EQU 0
CYDEV_CHIP_REVISION_4L_PRODUCTION EQU 0
CYDEV_CHIP_REVISION_4M_PRODUCTION EQU 0
CYDEV_CHIP_REVISION_4N_PRODUCTION EQU 0
CYDEV_CHIP_REVISION_4O_PRODUCTION EQU 0
CYDEV_CHIP_REVISION_4P_PRODUCTION EQU 0
CYDEV_CHIP_REVISION_4Q_PRODUCTION EQU 0
CYDEV_CHIP_REVISION_4R_PRODUCTION EQU 0
CYDEV_CHIP_REVISION_4S_PRODUCTION EQU 0
CYDEV_CHIP_REVISION_4T_PRODUCTION EQU 0
CYDEV_CHIP_REVISION_4U_PRODUCTION EQU 0
CYDEV_CHIP_REVISION_4V_PRODUCTION EQU 0
CYDEV_CHIP_REVISION_4W_PRODUCTION EQU 0
CYDEV_CHIP_REVISION_4X_PRODUCTION EQU 0
CYDEV_CHIP_REVISION_4Y_PRODUCTION EQU 0
CYDEV_CHIP_REVISION_4Z_PRODUCTION EQU 0
CYDEV_CHIP_REVISION_5A_ES0 EQU 0
CYDEV_CHIP_REVISION_5A_ES1 EQU 1
CYDEV_CHIP_REVISION_5A_PRODUCTION EQU 1
CYDEV_CHIP_REVISION_5B_ES0 EQU 0
CYDEV_CHIP_REVISION_5B_PRODUCTION EQU 0
CYDEV_CHIP_REVISION_6A_ES EQU 17
CYDEV_CHIP_REVISION_6A_NO_UDB EQU 33
CYDEV_CHIP_REVISION_6A_PRODUCTION EQU 33
CYDEV_CHIP_REVISION_FM3_PRODUCTION EQU 0
CYDEV_CHIP_REVISION_FM4_PRODUCTION EQU 0
CYDEV_CHIP_REVISION_PDL_FM0P_TYPE1_PRODUCTION EQU 0
CYDEV_CHIP_REVISION_PDL_FM0P_TYPE2_PRODUCTION EQU 0
CYDEV_CHIP_REVISION_PDL_FM0P_TYPE3_PRODUCTION EQU 0
CYDEV_CHIP_REVISION_USED EQU CYDEV_CHIP_REVISION_5B_PRODUCTION
CYDEV_CHIP_REV_EXPECT EQU CYDEV_CHIP_REVISION_USED
CYDEV_CONFIG_FASTBOOT_ENABLED EQU 1
CYDEV_CONFIG_UNUSED_IO_AllowButWarn EQU 0
CYDEV_CONFIG_UNUSED_IO EQU CYDEV_CONFIG_UNUSED_IO_AllowButWarn
CYDEV_CONFIG_UNUSED_IO_AllowWithInfo EQU 1
CYDEV_CONFIG_UNUSED_IO_Disallowed EQU 2
CYDEV_CONFIGURATION_COMPRESSED EQU 1
CYDEV_CONFIGURATION_DMA EQU 0
CYDEV_CONFIGURATION_ECC EQU 1
CYDEV_CONFIGURATION_IMOENABLED EQU CYDEV_CONFIG_FASTBOOT_ENABLED
CYDEV_CONFIGURATION_MODE_COMPRESSED EQU 0
CYDEV_CONFIGURATION_MODE EQU CYDEV_CONFIGURATION_MODE_COMPRESSED
CYDEV_CONFIGURATION_MODE_DMA EQU 2
CYDEV_CONFIGURATION_MODE_UNCOMPRESSED EQU 1
CYDEV_DEBUG_ENABLE_MASK EQU 0x20
CYDEV_DEBUG_ENABLE_REGISTER EQU CYREG_MLOGIC_DEBUG
CYDEV_DEBUGGING_DPS_Disable EQU 3
CYDEV_DEBUGGING_DPS_JTAG_4 EQU 1
CYDEV_DEBUGGING_DPS_JTAG_5 EQU 0
CYDEV_DEBUGGING_DPS_SWD EQU 2
CYDEV_DEBUGGING_DPS_SWD_SWV EQU 6
CYDEV_DEBUGGING_DPS EQU CYDEV_DEBUGGING_DPS_SWD_SWV
CYDEV_DEBUGGING_ENABLE EQU 1
CYDEV_DEBUGGING_XRES EQU 0
CYDEV_DMA_CHANNELS_AVAILABLE EQU 24
CYDEV_ECC_ENABLE EQU 0
CYDEV_HEAP_SIZE EQU 0x80
CYDEV_INSTRUCT_CACHE_ENABLED EQU 1
CYDEV_INTR_RISING EQU 0x00000000
CYDEV_IS_EXPORTING_CODE EQU 0
CYDEV_IS_IMPORTING_CODE EQU 0
CYDEV_PROJ_TYPE EQU 0
CYDEV_PROJ_TYPE_BOOTLOADER EQU 1
CYDEV_PROJ_TYPE_LAUNCHER EQU 5
CYDEV_PROJ_TYPE_LOADABLE EQU 2
CYDEV_PROJ_TYPE_LOADABLEANDBOOTLOADER EQU 4
CYDEV_PROJ_TYPE_MULTIAPPBOOTLOADER EQU 3
CYDEV_PROJ_TYPE_STANDARD EQU 0
CYDEV_PROTECTION_ENABLE EQU 0
CYDEV_STACK_SIZE EQU 0x0800
CYDEV_USE_BUNDLED_CMSIS EQU 1
CYDEV_VARIABLE_VDDA EQU 0
CYDEV_VDDA_MV EQU 5000
CYDEV_VDDD_MV EQU 5000
CYDEV_VDDIO0_MV EQU 5000
CYDEV_VDDIO1_MV EQU 5000
CYDEV_VDDIO2_MV EQU 5000
CYDEV_VDDIO3_MV EQU 5000
CYDEV_VIO0_MV EQU 5000
CYDEV_VIO1_MV EQU 5000
CYDEV_VIO2_MV EQU 5000
CYDEV_VIO3_MV EQU 5000
CYIPBLOCK_ARM_CM3_VERSION EQU 0
CYIPBLOCK_P3_ANAIF_VERSION EQU 0
CYIPBLOCK_P3_CAN_VERSION EQU 0
CYIPBLOCK_P3_CAPSENSE_VERSION EQU 0
CYIPBLOCK_P3_COMP_VERSION EQU 0
CYIPBLOCK_P3_DECIMATOR_VERSION EQU 0
CYIPBLOCK_P3_DFB_VERSION EQU 0
CYIPBLOCK_P3_DMA_VERSION EQU 0
CYIPBLOCK_P3_DRQ_VERSION EQU 0
CYIPBLOCK_P3_DSM_VERSION EQU 0
CYIPBLOCK_P3_EMIF_VERSION EQU 0
CYIPBLOCK_P3_I2C_VERSION EQU 0
CYIPBLOCK_P3_LCD_VERSION EQU 0
CYIPBLOCK_P3_LPF_VERSION EQU 0
CYIPBLOCK_P3_OPAMP_VERSION EQU 0
CYIPBLOCK_P3_PM_VERSION EQU 0
CYIPBLOCK_P3_SCCT_VERSION EQU 0
CYIPBLOCK_P3_TIMER_VERSION EQU 0
CYIPBLOCK_P3_USB_VERSION EQU 0
CYIPBLOCK_P3_VIDAC_VERSION EQU 0
CYIPBLOCK_P3_VREF_VERSION EQU 0
CYIPBLOCK_S8_GPIO_VERSION EQU 0
CYIPBLOCK_S8_IRQ_VERSION EQU 0
CYIPBLOCK_S8_SAR_VERSION EQU 0
CYIPBLOCK_S8_SIO_VERSION EQU 0
CYIPBLOCK_S8_UDB_VERSION EQU 0
DMA_CHANNELS_USED__MASK0 EQU 0x00000000
CYDEV_BOOTLOADER_ENABLE EQU 0
    ENDIF
    END
